## host/usb/Kconfig
```kconfig
menu "USB-OTG"
    depends on SOC_USB_OTG_SUPPORTED

    config USB_HOST_CONTROL_TRANSFER_MAX_SIZE
        int "Largest size (in bytes) of transfers to/from default endpoints"
        default 256
        help
            Each USB device attached is allocated a dedicated buffer for its OUT/IN transfers to/from the device's
            control endpoint. The maximum size of that buffer is determined by this option. The limited size of the
            transfer buffer have the following implications:
            - The maximum length of control transfers is limited
            - Device's with configuration descriptors larger than this limit cannot be supported

    config USB_HOST_ENUM_CTRL_TIMEOUT_MS
        int "Enumeration control transfer timeout (ms, 0 = none)"
        default 2000
        range 0 60000
        help
            If a control transfer sent while enumerating a device does not complete within this time (e.g.
            the device NAKs forever), the device's port is disabled so the enumeration is canceled. Ports are
            enumerated one at a time, so without a timeout one unresponsive device stops every other device
            from enumerating. The default can be changed at run time with usb_host_set_enum_timeout(), and per
            device with usb_host_set_enum_timeout_cb().

    config USB_HOST_PARKED_IN_BIND_CAP
        int "Max parked bulk IN listeners holding channels (0 = unlimited)"
        default 3
        range 0 16
        help
            A "parked listener" is a bulk IN pipe whose current transfer is short
            (num_bytes <= USB_HOST_PARKED_IN_MAX_PACKETS max-size packets) - e.g. a serial
            console session that keeps a small read posted.
            While such a pipe holds a hardware channel it NAK-polls the bus
            continuously, and enough of them saturate the bus: observed on a full-speed bus
            as mass-storage reads timing out (SCSI timeout) behind seven parked console
            readers. With this cap, at most this many parked listeners hold channels
            concurrently; the rest wait in the channel-waiter queue and are rotated in
            every USB_HOST_PARKED_IN_ROTATE_MS, so each still gets regular bus time.
            Multi-packet transfers are never capped. 0 disables both the cap and the
            rotation.

    config USB_HOST_PARKED_IN_ROTATE_MS
        int "Parked bulk IN listener rotation period (ms)"
        default 100
        range 5 1000
        help
            Period of the rotation tick that asks one parked bulk IN listener to yield
            its hardware channel while other pipes are waiting for one (see
            USB_HOST_PARKED_IN_BIND_CAP). The tick is the only place a yield is requested,
            at most one per tick. The worst-case extra latency for a parked listener is
            roughly (number of waiting listeners) x this period, which is fine for parked
            consoles. The tick pauses while a non-parked bulk transfer is executing.

    config USB_HOST_PARKED_IN_MAX_PACKETS
        int "Max packets for a bulk IN transfer to classify as a parked listener"
        default 4
        range 1 16
        help
            A bulk IN transfer counts as a parked listener when its length is at most
            this many max-size packets (num_bytes <= N x MPS). Real console read URBs
            are larger than one packet - Linux cdc-acm keeps 2 x MPS (128-byte) reads
            posted and cp210x larger still - so the default of 4 covers them, while
            mass-storage data transfers stay far above the threshold and are never
            capped or rotated.

    config USB_HOST_PARKED_IN_CHAN_RESERVE
        int "Free host channels reserved from parked bulk IN listeners"
        default 2
        range 0 8
        help
            Parked bulk IN listeners may only bind a channel while MORE than this
            many channels are free; the last channels are kept for non-parked
            transfers. The reserve exists because INTR pipe allocation is static and
            hard-fails (ESP_ERR_NOT_SUPPORTED) on channel exhaustion, so device
            interface re-claims after a reset must always find a channel. Non-parked
            binds (control, mass-storage data and status, and static INTR/ISOC
            allocation) are not affected.

    config USB_HOST_PARKED_INTR_BIND_CAP
        int "Max parked interrupt IN listeners holding channels (0 = static, feature disabled)"
        default 0
        range 0 16
        help
            Phase 3: interrupt IN pipes bind a host channel on demand instead of for life,
            as parked listeners (cdc-acm notification endpoints, hub status pipes). A parked
            interrupt listener is an IN interrupt pipe whose transfer is a single packet
            (num_bytes <= MPS). At most this many hold channels concurrently; the rest queue
            and rotate in with the bulk listeners. Interrupt pipes that do not match the
            single-packet test bind like non-parked bulk: uncapped, never yielded, and released
            when idle. 0 keeps every interrupt pipe statically bound, as before. Hub status
            change bits are latched by the hub until read, so delayed polling under rotation
            delays detection but does not lose it.

    choice USB_HOST_HW_BUFFER_BIAS
        prompt "Hardware FIFO size biasing"
        default USB_HOST_HW_BUFFER_BIAS_BALANCED
        help
            The underlying hardware has size adjustable FIFOs to cache USB packets on reception (IN) or for
            transmission (OUT). The size of these FIFOs will affect the largest MPS (maximum packet size) and the
            maximum number of packets that can be cached at any one time. The hardware contains the following
            FIFOS: RX (for all IN packets), Non-periodic TX (for Bulk and Control OUT packets), and Periodic TX
            (for Interrupt and Isochronous OUT packets). This configuration option allows biasing the FIFO sizes
            towards a particular use case, which may be necessary for devices that have endpoints with large MPS.

            The FIFO allocation formulas (where D = otg_dfifo_depth, Total = Total available FIFO size in lines):

            Balanced:
            - IN (RX FIFO) = Total - D/4 - D/8
            - OUT non-periodic (Non-periodic TX FIFO) = D/4
            - OUT periodic (Periodic TX FIFO) = D/8

            Bias IN:
            - IN (RX FIFO) = Total - D/16 - D/8
            - OUT non-periodic (Non-periodic TX FIFO) = D/16
            - OUT periodic (Periodic TX FIFO) = D/8

            Bias Periodic OUT:
            - IN (RX FIFO) = D/8 + 2 (2 extra lines for status information)
            - OUT non-periodic (Non-periodic TX FIFO) = D/16
            - OUT periodic (Periodic TX FIFO) = Total - D/16 - (D/8 + 2)

            Note:
            - Each line = 4 bytes. To convert FIFO size: bytes = lines × 4
            - D (otg_dfifo_depth) is typically 256 for FS PHY, 1024 for HS PHY (chip-dependent)
            - Total is slightly less than D due to controller overhead

        config USB_HOST_HW_BUFFER_BIAS_BALANCED
            bool "Balanced"
        config USB_HOST_HW_BUFFER_BIAS_IN
            bool "Bias IN"
        config USB_HOST_HW_BUFFER_BIAS_PERIODIC_OUT
            bool "Periodic OUT"
    endchoice

    menu "Hub Driver Configuration"

        menu "Root Port configuration"

            config USB_HOST_DEBOUNCE_DELAY_MS
                int "Debounce delay in ms"
                default 250
                help
                    On connection of a USB device, the USB 2.0 specification requires
                    a "debounce interval with a minimum duration of 100ms" to allow the connection to stabilize
                    (see USB 2.0 chapter 7.1.7.3 for more details).
                    During the debounce interval, no new connection/disconnection events are registered.

                    The default value is set to 250 ms to be safe.

            config USB_HOST_RESET_HOLD_MS
                int "Reset hold in ms"
                default 30
                help
                    The reset signaling can be generated on any Hub or Host Controller port by request from
                    the USB System Software. The USB 2.0 specification requires that "the reset signaling must
                    be driven for a minimum of 10ms" (see USB 2.0 chapter 7.1.7.5 for more details).
                    After the reset, the hub port will transition to the Enabled state (refer to Section 11.5).

                    The default value is set to 30 ms to be safe.

            config USB_HOST_RESET_RECOVERY_MS
                int "Reset recovery delay in ms"
                default 30
                help
                    After a port stops driving the reset signal, the USB 2.0 specification requires that
                    the "USB System Software guarantees a minimum of 10 ms for reset recovery" before the
                    attached device is expected to respond to data transfers (see USB 2.0 chapter 7.1.7.3 for
                    more details).
                    The device may ignore any data transfers during the recovery interval.

                    The default value is set to 30 ms to be safe.


            config USB_HOST_SET_ADDR_RECOVERY_MS
                int "SetAddress() recovery time in ms"
                default 10
                help
                    "After successful completion of the Status stage, the device is allowed a SetAddress()
                    recovery interval of 2 ms. At the end of this interval, the device must be able to accept
                    Setup packets addressed to the new address. Also, at the end of the recovery interval, the
                    device must not respond to tokens sent to the old address (unless, of course, the old and new
                    address is the same)." See USB 2.0 chapter 9.2.6.3 for more details.

                    The default value is set to 10 ms to be safe.

            config USB_HOST_RESUME_HOLD_MS
                int "Resume hold delay in ms"
                default 30
                help
                    "The host may signal resume (TDRSMDN) at any time. It must send the resume signaling for at least
                    20 ms and then end the resume signaling.."
                    See USB 2.0 chapter 7.1.7.7 for more details.

                    The default value is set to 30 ms to be safe.

            config USB_HOST_RESUME_RECOVERY_MS
                int "Resume recovery delay in ms"
                default 20
                help
                    "The USB System Software must provide a 10 ms resume recovery time (TRSMRCY) during which it will
                    not attempt to access any device connected to the affected (just-activated) bus segment."
                    See the USB 2.0 chapter 7.1.7.7 for more details.

                    The default value is set to 20 ms to be safe.

            config USB_HOST_SUSPEND_ENTRY_MS
                int "Suspend entry delay in ms"
                default 20
                help
                    "The device must actually be suspended, drawing only suspend current from the bus after no more
                    than 10 ms of bus inactivity on all its ports." See the USB 2.0 chapter 7.1.7.6 for more details.

                    The default values is set to 20 ms to be safe.

        endmenu #Root Hub configuration

        config USB_HOST_HUBS_SUPPORTED
            bool "Support Hubs"
            default n
            help
                Enables support of external Hubs.

        config USB_HOST_HUB_MULTI_LEVEL
            depends on USB_HOST_HUBS_SUPPORTED
            bool "Support multiple Hubs"
            default y
            help
                Enables support for connecting multiple Hubs simultaneously.

        menu "Downstream Port configuration"
            depends on USB_HOST_HUBS_SUPPORTED

            config USB_HOST_EXT_PORT_RESET_ATTEMPTS
                depends on IDF_EXPERIMENTAL_FEATURES
                # Invisible config option
                # Todo: IDF-11283
                int
                default 1
                help
                    Amount of attempts to reset the device.

                    The default value is 1.

            config USB_HOST_EXT_PORT_RESET_RECOVERY_DELAY_MS
                int "Reset recovery delay in ms"
                default 30
                help
                    After a port stops driving the reset signal, the USB 2.0 specification requires that
                    the "USB System Software guarantees a minimum of 10 ms for reset recovery" before the
                    attached device is expected to respond to data transfers (see USB 2.0 chapter 7.1.7.3 for
                    more details).
                    The device may ignore any data transfers during the recovery interval.

                    The default value is set to 30 ms to be safe.

            config USB_HOST_EXT_PORT_CUSTOM_POWER_ON_DELAY_ENABLE
                bool "Custom bPwrOn2PwrGood value"
                default n
                help
                    Enables the possibility to configure custom time for the power-on sequence on a port
                    until power is good on that port.

                    When enabled, applies the custom PwrOn2PwrGood delay.
                    When disabled, applies the PwrOn2PwrGood value from the Hub Descriptor.

            config USB_HOST_EXT_PORT_CUSTOM_POWER_ON_DELAY_MS
                depends on USB_HOST_EXT_PORT_CUSTOM_POWER_ON_DELAY_ENABLE
                int "PwrOn2PwrGood delay in ms"
                default 100
                range 0 5000
                help
                    Custom value of delay from the time the power-on sequence begins on a port
                    until power is good on that port.
                    Value 0 is used for a hub with no power switches.

                    The default value is 100 ms.

        endmenu #Downstream Port configuration

    endmenu #Hub Driver Configuration

    config USB_HOST_ENABLE_ENUM_FILTER_CALLBACK
        bool "Enable enumeration filter callback"
        default n
        help
            The enumeration filter callback is called before enumeration of each newly attached device.
            This callback allows users to control whether a device should be enumerated, and what configuration
            number to use when enumerating a device.

            If enabled, the enumeration filter callback can be set via 'usb_host_config_t' when calling
            'usb_host_install()'.

    config USB_HOST_DWC_DMA_CAP_MEMORY_IN_PSRAM
        depends on IDF_TARGET_ESP32P4 && SPIRAM
        bool "Allocate USB_DWC DMA capable memory in PSRAM"
        default n
        help
            In the ESP32P4, the USB-DWC internal DMA can access external RAM. Enabling this configuration can save
            internal RAM by allocating the memory buffers used by the USB-DWC peripheral's DMA to external RAM.
            However, it introduces minor performance degradation due to the overhead of accessing external RAM.
        # Todo: IDF-11368 (aligned memory alloc size)

    # Hidden or compatibility options
    config USB_OTG_SUPPORTED
        # Invisible config kept for compatibility
        # Todo: Remove in v6.0 (IDF-8936)
        bool
        default y

endmenu #USB-OTG
```
