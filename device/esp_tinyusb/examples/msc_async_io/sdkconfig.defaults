## device/esp_tinyusb/examples/msc_ncm_async_io/main/Kconfig.projbuild
```kconfig
menu "MSC + NCM async IO example"

    choice EXAMPLE_STORAGE
        prompt "Storage exposed over USB"
        default EXAMPLE_STORAGE_SDCARD if IDF_TARGET_ESP32P4
        default EXAMPLE_STORAGE_FLASH

        config EXAMPLE_STORAGE_SDCARD
            bool "SD card"
            depends on SOC_SDMMC_HOST_SUPPORTED
            help
                microSD card on a 4-bit SDMMC slot. The device never mounts or
                formats the card, the host sees it as it is. Use a scratch card.
                Default pins match the ESP32-P4-Function-EV-Board.

        config EXAMPLE_STORAGE_FLASH
            bool "Internal flash"
            help
                The "storage" flash partition (2 MB, FAT, wear levelled).
                Flash writes and erases disable the cache on all cores, which
                stalls all tasks briefly, even with async IO.
    endchoice

    menu "SD card slot"
        depends on EXAMPLE_STORAGE_SDCARD

        config EXAMPLE_SD_PIN_CLK
            int "CLK GPIO"
            default 43
        config EXAMPLE_SD_PIN_CMD
            int "CMD GPIO"
            default 44
        config EXAMPLE_SD_PIN_D0
            int "D0 GPIO"
            default 39
        config EXAMPLE_SD_PIN_D1
            int "D1 GPIO"
            default 40
        config EXAMPLE_SD_PIN_D2
            int "D2 GPIO"
            default 41
        config EXAMPLE_SD_PIN_D3
            int "D3 GPIO"
            default 42
        config EXAMPLE_SD_LDO_CHAN
            int "On-chip LDO channel powering the SD card IO (-1: none)"
            default 4 if IDF_TARGET_ESP32P4
            default -1
            range -1 4
    endmenu

    config EXAMPLE_MEDIUM_DELAY_MS
        int "Simulated slow medium delay per storage access (ms)"
        default 0
        range 0 1000
        help
            Every storage read and write sleeps this long before accessing the
            medium, to make a fast medium behave like a slow one. Reads and
            writes become proportionally slower.

    config EXAMPLE_NCM_TX_RETRY_BUSY
        bool "Retry NCM transmit while all IN NTB buffers are full (debug)"
        default n
        help
            tinyusb_net_send_sync() fails at once when all IN NTB buffers are in
            flight, and the frame is dropped. With this option, the lwIP task
            waits one tick and retries, for up to 100 ms, instead of dropping.

endmenu
```

## device/esp_tinyusb/examples/msc_ncm_async_io/sdkconfig.defaults.esp32p4
```kconfig
# ESP32-P4 chip revision 3.x
CONFIG_ESP32P4_SELECTS_REV_LESS_V3=n
CONFIG_ESP32P4_REV_MIN_301=y
```

## device/esp_tinyusb/test_apps/msc_async_bench/main/Kconfig.projbuild
```kconfig
menu "MSC async IO benchmark"

    choice BENCH_STORAGE
        prompt "Storage exposed over MSC"
        default BENCH_STORAGE_RAMDISK

        config BENCH_STORAGE_RAMDISK
            bool "RAM disk"
            help
                RAM-backed block device. Combine with the storage delay to emulate
                slow media with predictable timing.

        config BENCH_STORAGE_SDCARD
            bool "SD card (ESP32-P4-Function-EV-Board)"
            depends on IDF_TARGET_ESP32P4
            help
                microSD card in the ESP32-P4-Function-EV-Board slot, 4-bit SDMMC,
                exposed through sdmmc_get_blockdev(). The device never mounts or
                formats the card. Use a scratch card formatted FAT32 on the host.
    endchoice

    config BENCH_RAMDISK_SIZE_KB
        int "RAM disk size (KiB)"
        depends on BENCH_STORAGE_RAMDISK
        default 4096 if SPIRAM
        default 192
        help
            Size of the RAM-backed block device exposed over MSC. Allocated from
            PSRAM when available, otherwise from internal RAM.

    choice BENCH_SD_SPEED
        prompt "SD card bus speed"
        depends on BENCH_STORAGE_SDCARD
        default BENCH_SD_HIGHSPEED

        config BENCH_SD_HIGHSPEED
            bool "High Speed (40 MHz)"
        config BENCH_SD_DEFAULT_SPEED
            bool "Default Speed (20 MHz)"
    endchoice

    config BENCH_SD_LDO_CHAN
        int "On-chip LDO channel powering the SD card IO"
        depends on BENCH_STORAGE_SDCARD
        default 4

    config BENCH_IO_DELAY_MS
        int "Initial added storage delay per IO (ms)"
        default 0
        range 0 1000
        help
            Every read and write of the storage sleeps this long before
            completing, to emulate slow media. The host can change it at runtime
            (see README).
            With the SD card, the delay is added on top of the card's own access
            time. Use 0 to measure the card alone.

endmenu
```

## device/esp_tinyusb/test_apps/msc_async_io/main/Kconfig.projbuild
```kconfig
menu "MSC async IO test app"

    config TEST_RAMDISK_SIZE_KB
        int "RAM disk size (KiB)"
        default 4096 if SPIRAM
        default 192
        help
            Size of the RAM-backed block device exposed over MSC. Allocated from
            PSRAM when available, otherwise from internal RAM.

    config TEST_IO_DELAY_MS
        int "Initial added storage delay per IO (ms)"
        default 0
        range 0 1000
        help
            Every read and write of the RAM disk sleeps this long before
            completing, to emulate slow media. The host can change it at runtime
            (see README).

endmenu
```

## device/esp_tinyusb/test_apps/power_management/sdkconfig.defaults.esp32p4
```kconfig
CONFIG_ESP32P4_SELECTS_REV_LESS_V3=n
CONFIG_ESP32P4_REV_MIN_301=y

CONFIG_PM_POWER_DOWN_PERIPHERAL_IN_LIGHT_SLEEP=y
```

## device/esp_tinyusb/test_apps/runtime_composite/sdkconfig.defaults
```kconfig
CONFIG_TINYUSB_CDC_ENABLED=y
CONFIG_TINYUSB_CDC_COUNT=2
CONFIG_TINYUSB_MSC_ENABLED=y
CONFIG_TINYUSB_HID_COUNT=1
CONFIG_TINYUSB_MIDI_COUNT=1
CONFIG_TINYUSB_VENDOR_COUNT=2
CONFIG_TINYUSB_NET_MODE_NCM=y
CONFIG_TINYUSB_DESC_USE_DEFAULT_PID=y
```

## host/class/cdc/usb_host_cdc_common/test_apps/sdkconfig.defaults
```kconfig
CONFIG_FREERTOS_HZ=1000
CONFIG_FREERTOS_TIMER_TASK_STACK_DEPTH=4096
CONFIG_USB_HOST_HUBS_SUPPORTED=y
CONFIG_USB_HOST_CONTROL_TRANSFER_MAX_SIZE=4096
CONFIG_ESP_TASK_WDT_INIT=n
```
