## host/usb/test/mocks/hcd_layer_mock/usb/Kconfig
```kconfig
menu "HCD layer mock"

    choice USB_HOST_HW_BUFFER_BIAS
        prompt "Hardware FIFO size biasing"
        default USB_HOST_HW_BUFFER_BIAS_BALANCED
        help
            The underlying hardware has size adjustable FIFOs to cache USB packets on reception (IN) or for
            transmission (OUT). The size of these FIFOs will affect the largest MPS (maximum packet size) and the
            maximum number of packets that can be cached at any one time. The hardware contains the following
            FIFOS: RX (for all IN packets), Non-periodic TX (for Bulk and Control OUT packets), and Periodic TX
            (for Interrupt and Isochronous OUT packets). This configuration option allows biasing the FIFO sizes
            towards a particular use case, which may be necessary for devices that have endpoints with large MPS.

            The FIFO allocation formulas (where D = otg_dfifo_depth, Total = Total available FIFO size in lines):

            Balanced:
            - IN (RX FIFO) = Total - D/4 - D/8
            - OUT non-periodic (Non-periodic TX FIFO) = D/4
            - OUT periodic (Periodic TX FIFO) = D/8

            Bias IN:
            - IN (RX FIFO) = Total - D/16 - D/8
            - OUT non-periodic (Non-periodic TX FIFO) = D/16
            - OUT periodic (Periodic TX FIFO) = D/8

            Bias Periodic OUT:
            - IN (RX FIFO) = D/8 + 2 (2 extra lines for status information)
            - OUT non-periodic (Non-periodic TX FIFO) = D/16
            - OUT periodic (Periodic TX FIFO) = Total - D/16 - (D/8 + 2)

            Note:
            - Each line = 4 bytes. To convert FIFO size: bytes = lines × 4
            - D (otg_dfifo_depth) is typically 256 for FS PHY, 1024 for HS PHY (chip-dependent)
            - Total is slightly less than D due to controller overhead

        config USB_HOST_HW_BUFFER_BIAS_BALANCED
            bool "Balanced"
        config USB_HOST_HW_BUFFER_BIAS_IN
            bool "Bias IN"
        config USB_HOST_HW_BUFFER_BIAS_PERIODIC_OUT
            bool "Periodic OUT"
    endchoice

    menu "Hub Driver Configuration"

        menu "Root Port configuration"

            config USB_HOST_DEBOUNCE_DELAY_MS
                int "Debounce delay in ms"
                default 250
                help
                    On connection of a USB device, the USB 2.0 specification requires
                    a "debounce interval with a minimum duration of 100ms" to allow the connection to stabilize
                    (see USB 2.0 chapter 7.1.7.3 for more details).
                    During the debounce interval, no new connection/disconnection events are registered.

                    The default value is set to 250 ms to be safe.

            config USB_HOST_RESET_HOLD_MS
                int "Reset hold in ms"
                default 30
                help
                    The reset signaling can be generated on any Hub or Host Controller port by request from
                    the USB System Software. The USB 2.0 specification requires that "the reset signaling must
                    be driven for a minimum of 10ms" (see USB 2.0 chapter 7.1.7.5 for more details).
                    After the reset, the hub port will transition to the Enabled state (refer to Section 11.5).

                    The default value is set to 30 ms to be safe.

            config USB_HOST_RESET_RECOVERY_MS
                int "Reset recovery delay in ms"
                default 30
                help
                    After a port stops driving the reset signal, the USB 2.0 specification requires that
                    the "USB System Software guarantees a minimum of 10 ms for reset recovery" before the
                    attached device is expected to respond to data transfers (see USB 2.0 chapter 7.1.7.3 for
                    more details).
                    The device may ignore any data transfers during the recovery interval.

                    The default value is set to 30 ms to be safe.


            config USB_HOST_SET_ADDR_RECOVERY_MS
                int "SetAddress() recovery time in ms"
                default 10
                help
                    "After successful completion of the Status stage, the device is allowed a SetAddress()
                    recovery interval of 2 ms. At the end of this interval, the device must be able to accept
                    Setup packets addressed to the new address. Also, at the end of the recovery interval, the
                    device must not respond to tokens sent to the old address (unless, of course, the old and new
                    address is the same)." See USB 2.0 chapter 9.2.6.3 for more details.

                    The default value is set to 10 ms to be safe.

            config USB_HOST_RESUME_HOLD_MS
                int "Resume hold delay in ms"
                default 30
                help
                    "The host may signal resume (TDRSMDN) at any time. It must send the resume signaling for at least
                    20 ms and then end the resume signaling.."
                    See USB 2.0 chapter 7.1.7.7 for more details.

                    The default value is set to 30 ms to be safe.

            config USB_HOST_RESUME_RECOVERY_MS
                int "Resume recovery delay in ms"
                default 20
                help
                    "The USB System Software must provide a 10 ms resume recovery time (TRSMRCY) during which it will
                    not attempt to access any device connected to the affected (just-activated) bus segment."
                    See the USB 2.0 chapter 7.1.7.7 for more details.

                    The default value is set to 20 ms to be safe.

            config USB_HOST_SUSPEND_ENTRY_MS
                int "Suspend entry delay in ms"
                default 20
                help
                    "The device must actually be suspended, drawing only suspend current from the bus after no more
                    than 10 ms of bus inactivity on all its ports." See the USB 2.0 chapter 7.1.7.6 for more details.

                    The default values is set to 20 ms to be safe.

        endmenu #Root Hub configuration

    endmenu #Hub Driver Configuration

    # Hidden or compatibility options
    config USB_OTG_SUPPORTED
        # Invisible config kept for compatibility
        # Todo: Remove in v6.0 (IDF-8936)
        bool
        default y

endmenu #USB-OTG
```
