## device/esp_tinyusb/test_apps/power_management/sdkconfig.defaults
```kconfig
# Configure TinyUSB, it will be used to mock USB devices
CONFIG_TINYUSB_MSC_ENABLED=n
CONFIG_TINYUSB_CDC_ENABLED=y
CONFIG_TINYUSB_CDC_COUNT=1
CONFIG_TINYUSB_HID_COUNT=0

# Disable watchdogs, they'd get triggered during unity interactive menu
# CONFIG_ESP_TASK_WDT_INIT is not set

CONFIG_UNITY_ENABLE_BACKTRACE_ON_FAIL=y
CONFIG_COMPILER_CXX_EXCEPTIONS=y
```

## device/esp_tinyusb/test_apps/uvc/sdkconfig.defaults
```kconfig
#
# USB Video Class (UVC)
#
CONFIG_TINYUSB_UVC_ENABLED=y
CONFIG_TINYUSB_DESC_UVC_STRING="Espressif UVC Camera"
# CONFIG_TINYUSB_UVC_SUPPORT_TWO_CAM is not set
CONFIG_TINYUSB_UVC_CAM1_FRAMERATE=15
CONFIG_TINYUSB_UVC_CAM1_FRAMESIZE_WIDTH=640
CONFIG_TINYUSB_UVC_CAM1_FRAMESIZE_HEIGHT=480
CONFIG_TINYUSB_UVC_FORMAT_MJPEG_CAM1=y
# CONFIG_TINYUSB_UVC_FORMAT_H264_CAM1 is not set
# CONFIG_TINYUSB_UVC_CAM1_MULTI_FRAMESIZE is not set
# CONFIG_TINYUSB_UVC_CAM1_BULK_MODE is not set
CONFIG_TINYUSB_UVC_MULTI_FRAME_WIDTH_1=640
CONFIG_TINYUSB_UVC_MULTI_FRAME_HEIGHT_1=480
CONFIG_TINYUSB_UVC_MULTI_FRAME_FPS_1=15
CONFIG_TINYUSB_UVC_MULTI_FRAME_WIDTH_2=320
CONFIG_TINYUSB_UVC_MULTI_FRAME_HEIGHT_2=240
CONFIG_TINYUSB_UVC_MULTI_FRAME_FPS_2=15
CONFIG_TINYUSB_UVC_MULTI_FRAME_WIDTH_3=160
CONFIG_TINYUSB_UVC_MULTI_FRAME_HEIGHT_3=120
CONFIG_TINYUSB_UVC_MULTI_FRAME_FPS_3=15
CONFIG_TINYUSB_UVC_CAM1_TASK_PRIORITY=5
CONFIG_TINYUSB_UVC_CAM1_TASK_CORE=-1
CONFIG_TINYUSB_UVC_TINYUSB_TASK_PRIORITY=5
CONFIG_TINYUSB_UVC_TINYUSB_TASK_CORE=-1
# end of USB Video Class (UVC)

# Partitions configuration, used by spiflash storage
CONFIG_PARTITION_TABLE_CUSTOM=y
CONFIG_PARTITION_TABLE_CUSTOM_FILENAME="partitions.csv"
CONFIG_PARTITION_TABLE_FILENAME="partitions.csv"
CONFIG_ESPTOOLPY_FLASHSIZE_4MB=y
CONFIG_WL_SECTOR_SIZE_512=y
CONFIG_WL_SECTOR_MODE_PERF=y

# On chips with USB Serial JTAG, disable secondary console which does not make sense when using console component
CONFIG_ESP_CONSOLE_SECONDARY_NONE=y

# Disable watchdogs, they'd get triggered during unity interactive menu
CONFIG_ESP_INT_WDT=n
CONFIG_ESP_TASK_WDT=n

# Run-time checks of Heap and Stack
CONFIG_HEAP_POISONING_COMPREHENSIVE=y
CONFIG_COMPILER_STACK_CHECK_MODE_STRONG=y
CONFIG_COMPILER_STACK_CHECK=y

CONFIG_UNITY_ENABLE_BACKTRACE_ON_FAIL=y

CONFIG_COMPILER_CXX_EXCEPTIONS=y
```

## host/class/uac/usb_host_uac/Kconfig
```kconfig
menu "USB Host UAC"
    config PRINTF_UAC_CONFIGURATION_DESCRIPTOR
        bool "Print UAC Configuration Descriptor"
        default y
        help
            Print UAC Configuration Descriptor to console.
    config UAC_NUM_ISOC_URBS
        int "Number of UAC ISOC URBs"
        default 3
        help
            Number of UAC ISOC URBs to use. Fewer URBs could cause audio dropouts.
            More URBs will increase the RAM usage.
    config UAC_NUM_PACKETS_PER_URB
        int "Number of Packets per UAC ISOC URB"
        default 8
        help
            Number of Packets per UAC ISOC URB. It limits the minimum packets each transfer will send.
endmenu # "USB Host UAC"
```

## host/class/uac/usb_host_uac/examples/audio_player/main/Kconfig.projbuild
```kconfig
menu "Example USB Audio Player"
    config EXAMPLE_MIC_PLAYBACK
        bool "Playback audio from microphone"
        default n
        help
            Enable this to playback audio from microphone

    config EXAMPLE_SPK_SAMPLE_FREQ
        int "Speaker sample frequency in Hz (0 = auto)"
        default 0
        range 0 196000
        help
            Target sample frequency for the speaker output stream in Hz.
            The driver searches the device's supported alternate settings for
            a matching frequency. If not found, the first frequency reported
            by the device is used instead.
            Set to 0 to always use the device's first reported frequency.
            Common values: 44100, 48000, 32000, 16000.

    config EXAMPLE_MIC_SAMPLE_FREQ
        int "Microphone sample frequency in Hz (0 = auto)"
        default 0
        range 0 196000
        depends on EXAMPLE_MIC_PLAYBACK
        help
            Target sample frequency for the microphone input stream in Hz.
            Set to 0 to use the first frequency reported by the device.

endmenu
```

## host/class/uac/usb_host_uac/test_app/main/Kconfig.projbuild
```kconfig
menu "USB Component override"
    config USB_COMPONENT_OVERRIDE
        bool "Override esp-idf USB Component with esp-usb USB Component"
        default n
endmenu
```

## host/class/uvc/usb_host_uvc/Kconfig
```kconfig
menu "USB HOST UVC"

    config UVC_PRINTF_CONFIGURATION_DESCRIPTOR
        bool "Print UVC Configuration Descriptor"
        default n
        help
            Print UVC Configuration Descriptor to console.

    config UVC_INTERVAL_ARRAY_SIZE
        int "Size of the interval array in uvc_host_frame_info_t"
        default 3
        help
            This option sets the size of the interval array in the `uvc_host_frame_info_t` structure.
            Increase this value if you need to support more discrete frame intervals.

    config UVC_CHECK_PAYLOAD_HEADER_EOH
        bool "Check EOH bit in payload header"
        default y
        help
            "If EOH is set in the header, this is the last header group in the packet"
endmenu
```

## host/class/uvc/usb_host_uvc/examples/basic_uvc_stream/sdkconfig.defaults.esp32p4
```kconfig
CONFIG_ESP32P4_REV_MIN_0=y
CONFIG_RTC_CLK_SRC_EXT_CRYS=y
CONFIG_RTC_CLK_CAL_CYCLES=1024
CONFIG_SPIRAM_SPEED_200M=y
```

## host/usb/test/host_test/usb_host_layer_test/sdkconfig.defaults
```kconfig
CONFIG_IDF_TARGET="linux"
CONFIG_COMPILER_CXX_EXCEPTIONS=y
CONFIG_UNITY_ENABLE_IDF_TEST_RUNNER=n
CONFIG_USB_HOST_ENABLE_ENUM_FILTER_CALLBACK=y
```

## host/usb/test/mocks/usb_host_layer_mock/usb/Kconfig
```kconfig
# Config item from the original USB component needed for this CMock build

menu "USB Host Layer mock"

    config USB_HOST_CONTROL_TRANSFER_MAX_SIZE
        int "Largest size (in bytes) of transfers to/from default endpoints"
        default 256
        help
            Each USB device attached is allocated a dedicated buffer for its OUT/IN transfers to/from the device's
            control endpoint. The maximum size of that buffer is determined by this option. The limited size of the
            transfer buffer have the following implications:
            - The maximum length of control transfers is limited
            - Device's with configuration descriptors larger than this limit cannot be supported

    config USB_HOST_ENABLE_ENUM_FILTER_CALLBACK
        bool "Enable enumeration filter callback"
        default n
        help
            The enumeration filter callback is called before enumeration of each newly attached device.
            This callback allows users to control whether a device should be enumerated, and what configuration
            number to use when enumerating a device.

            If enabled, the enumeration filter callback can be set via 'usb_host_config_t' when calling
            'usb_host_install()'.

endmenu
```

## static_analysis/sdkconfig.defaults
```kconfig
CONFIG_COMPILER_CXX_EXCEPTIONS=y

# Enable all tinyusb classes, to include all the src files from the esp_tinyusb component to the analysis
CONFIG_TINYUSB_CDC_ENABLED=y
CONFIG_TINYUSB_MSC_ENABLED=y
CONFIG_TINYUSB_NET_MODE_NCM=y

# Enable external hubs
CONFIG_USB_HOST_HUBS_SUPPORTED=y
```

## type_c/usb_tcpm/Kconfig.pd_fusb302
```kconfig
menu "FUSB302 TCPM Configuration"

    orsource "$IDF_PATH/examples/common_components/env_caps/$IDF_TARGET/Kconfig.env_caps"

    config USB_TCPM_PD_FUSB302_I2C_SDA_GPIO
        int "I2C SDA GPIO number"
        range ENV_GPIO_RANGE_MIN ENV_GPIO_OUT_RANGE_MAX
        default 7
        help
            GPIO number for the I2C SDA line.

    config USB_TCPM_PD_FUSB302_I2C_SCL_GPIO
        int "I2C SCL GPIO number"
        range ENV_GPIO_RANGE_MIN ENV_GPIO_OUT_RANGE_MAX
        default 8
        help
            GPIO number for the I2C SCL line.

    config USB_TCPM_PD_FUSB302_FUSB_INT_GPIO
        int "FUSB302 INT GPIO number"
        range ENV_GPIO_RANGE_MIN ENV_GPIO_IN_RANGE_MAX
        default 9
        help
            GPIO number for the FUSB302 interrupt line.

    config USB_TCPM_PD_FUSB302_VBUS_GPIO_PH
        int "VBUS enable GPIO (active high)"
        range ENV_GPIO_RANGE_MIN ENV_GPIO_OUT_RANGE_MAX
        default 28 if IDF_TARGET_ESP32
        default 28 if IDF_TARGET_ESP32S2
        default 28 if IDF_TARGET_ESP32S3
        default 28 if IDF_TARGET_ESP32P4
        default 28 if IDF_TARGET_ESP32H4
        default 28 if IDF_TARGET_ESP32C5
        default 28 if IDF_TARGET_ESP32C6
        default 28 if IDF_TARGET_ESP32C61
        default 4
        help
            Active-high VBUS enable GPIO.

    config USB_TCPM_PD_FUSB302_VBUS_GPIO_N
        int "VBUS enable GPIO (active low)"
        range ENV_GPIO_RANGE_MIN ENV_GPIO_OUT_RANGE_MAX
        default 15
        help
            Active-low VBUS enable GPIO.

endmenu
```

## type_c/usb_tcpm/examples/pd_fusb302/sdkconfig.defaults
```kconfig
# Keep mbedTLS crypto features aligned with current Kconfig defaults.
# CONFIG_MBEDTLS_ARIA_C is not set
# CONFIG_MBEDTLS_SHA3_C is not set

# Keep target/flash defaults aligned with current Kconfig defaults.
CONFIG_ESPTOOLPY_FLASHFREQ_40M=y

# Keep libc console line-ending behavior explicit.
CONFIG_LIBC_STDOUT_LINE_ENDING_CRLF=y
CONFIG_LIBC_STDIN_LINE_ENDING_CR=y
```

## type_c/usb_tcpm/test_apps/pd_fusb302/sdkconfig.defaults
```kconfig
# Disable watchdogs, they'd get triggered during unity interactive menu
# CONFIG_ESP_TASK_WDT_INIT is not set

# Run-time checks of Heap and Stack
CONFIG_HEAP_POISONING_COMPREHENSIVE=y
CONFIG_COMPILER_STACK_CHECK_MODE_STRONG=y

CONFIG_UNITY_ENABLE_BACKTRACE_ON_FAIL=y

# Use USB Serial/JTAG for console I/O (Unity menu input/output)
CONFIG_ESP_CONSOLE_USB_SERIAL_JTAG=y
CONFIG_ESP_CONSOLE_SECONDARY_NONE=y
# CONFIG_ESP_CONSOLE_UART_DEFAULT is not set
# CONFIG_ESP_CONSOLE_UART_CUSTOM is not set
# CONFIG_ESP_CONSOLE_NONE is not set

# Keep mbedTLS crypto features aligned with current Kconfig defaults.
# CONFIG_MBEDTLS_ARIA_C is not set
# CONFIG_MBEDTLS_SHA3_C is not set

# Keep target/flash defaults aligned with current Kconfig defaults.
CONFIG_ESPTOOLPY_FLASHFREQ_40M=y
```
